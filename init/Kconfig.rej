## init/Kconfig.rej
```kconfig
--- init/Kconfig
+++ init/Kconfig
@@ -441,7 +454,7 @@
 
 config GROUP_SCHED
 	bool "Group CPU scheduler"
-	depends on EXPERIMENTAL
+	depends on EXPERIMENTAL && !SCHED_BFS
 	default n
 	help
 	  This feature lets CPU scheduler recognize task groups and control CPU
```
